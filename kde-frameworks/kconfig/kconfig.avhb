## kde-frameworks/kconfig/kconfig.avhb
```kconfig
# Copyright 2010-2025 Avouch Authors
# Distributed under the terms of the GNU General Public License v2
# Maintainer: Qurban Ullah <qurbanullah@avouch.org>
# Contributor: Qurban Ullah <qurbanullah@avouch.org>

pkgname=kconfig
pkgver=6.11.0
pkgrel=1
pkgdesc='Configuration system'
arch=('x86_64')
groups=('kde-frameworks')
url='https://community.kde.org/Frameworks'
license=('LGPL')
depends=('qt5-base')
depends=(gcc-libs
         glibc
         qt6-base
         qt6-declarative)
makedepends=(doxygen
             extra-cmake-modules
             qt6-doc
             qt6-tools)
source=(https://download.kde.org/stable/frameworks/${pkgver%.*}/$pkgname-$pkgver.tar.xz{,.sig})
sha256sums=('070bd019b07e15201e4c7072b71337c75f6917407406a1a7107fca1bff2855fe'
            'SKIP')
validpgpkeys=(53E6B47B45CEA3E0D5B7457758D0EE648A48B3BB # David Faure <faure@kde.org>
              E0A3EB202F8E57528E13E72FD7574483BB57B18D # Jonathan Esk-Riddell <jr@jriddell.org>
              90A968ACA84537CC27B99EAF2C8DF587A6D4AAC1 # Nicolas Fella <nicolas.fella@kde.org>
              )

build() {
  cmake -B build -S $pkgname-$pkgver \
    -DCMAKE_INSTALL_LIBEXECDIR=lib \
    -DBUILD_TESTING=OFF \
    -DBUILD_QCH=ON
  cmake --build build
}

package() {
  DESTDIR="$pkgdir" cmake --install build
}
```
